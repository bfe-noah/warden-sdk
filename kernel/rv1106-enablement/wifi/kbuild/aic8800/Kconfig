## kernel/rv1106-enablement/wifi/kbuild/aic8800/aic8800_btlpm/Kconfig
```kconfig
config AIC8800_BTLPM_SUPPORT
	tristate "AIC8800 bluetooth Support"
	default y
	help
	  This is support for the aic8800 bluetooth low-power-mode / HCI
	  wake companion module (aic8800_btlpm). Built-in (y) by default —
	  see the aic8800 port notes in warden-sdk/kernel/rv1106-enablement/wifi/.
```

## kernel/rv1106-enablement/wifi/kbuild/aic8800/aic8800_fdrv/Kconfig
```kconfig
config AIC8800_WLAN_SUPPORT
	tristate "AIC8800 wlan Support"
	default y
	help
	  This is support for the aic8800 cfg80211 full-MAC wifi driver
	  (aic8800_fdrv). Built-in (y) by default — see the aic8800 port
	  notes in warden-sdk/kernel/rv1106-enablement/wifi/.
```
